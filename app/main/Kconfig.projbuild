## app/main/Kconfig.projbuild
```kconfig
menu "I4A capture diagnostics"
config I4A_CAPTURE_DIAGNOSTICS
    bool "Emit periodic UART route, coordination, radio and heap snapshots"
    default n
    help
        Passive diagnostics independent of the normal log level. Adds one task
        and UART traffic, but does not change the ring or wireless protocol.
endmenu
```

## components/internal/spi/Kconfig
```kconfig
menu "Internet for all: SPI Configuration"
    choice SPI_FREQ
        prompt "SPI Freq"
        default SPI_FREQ_8M

    config SPI_FREQ_8M
        bool "SPI_FREQ_8M"
    config SPI_FREQ_9M
        bool "SPI_FREQ_9M"
    config SPI_FREQ_10M
        bool "SPI_FREQ_10M"
    config SPI_FREQ_11M
        bool "SPI_FREQ_11M"
    config SPI_FREQ_13M
        bool "SPI_FREQ_13M"
    config SPI_FREQ_16M
        bool "SPI_FREQ_16M"
    config SPI_FREQ_20M
        bool "SPI_FREQ_20M"
    config SPI_FREQ_26M
        bool "SPI_FREQ_26M"
    config SPI_FREQ_40M
        bool "SPI_FREQ_40M"
    config SPI_FREQ_80M
        bool "SPI_FREQ_80M"
    endchoice

    config SPI_BUFFER_SIZE
        int "SPI Buffer size"
        range 200 1600
        default 1600

    config SPI_RX_EXTRA_BUFFERS
        int "Additional SPI RX buffers for deferred consumers"
        range 0 16
        default 0
        help
            Keep eight DMA transactions armed while completed frames are held
            by consumer tasks. Each extra buffer uses SPI_BUFFER_SIZE bytes.
            Experimental software control; does not change wire format or clock.

endmenu
```
